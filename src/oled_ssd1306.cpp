#include "oled_ssd1306.h"
#include "config.h"
#include "driver/i2c.h"
#include "freertos/FreeRTOS.h"
#include <cstring>
#include <cctype>

static constexpr uint8_t ADDR = 0x3C;
static uint8_t fb[128 * 8];

struct Glyph { char c; uint8_t col[5]; };
static const Glyph FONT[] = {
 {' ',{0,0,0,0,0}},{'%',{0x23,0x13,0x08,0x64,0x62}},{'-',{8,8,8,8,8}},{'.',{0,0x60,0x60,0,0}},{':',{0,0x36,0x36,0,0}},{'!',{0,0,0x5F,0,0}},
 {'0',{0x3E,0x51,0x49,0x45,0x3E}},{'1',{0,0x42,0x7F,0x40,0}},{'2',{0x42,0x61,0x51,0x49,0x46}},{'3',{0x21,0x41,0x45,0x4B,0x31}},
 {'4',{0x18,0x14,0x12,0x7F,0x10}},{'5',{0x27,0x45,0x45,0x45,0x39}},{'6',{0x3C,0x4A,0x49,0x49,0x30}},{'7',{1,0x71,9,5,3}},
 {'8',{0x36,0x49,0x49,0x49,0x36}},{'9',{6,0x49,0x49,0x29,0x1E}},
 {'A',{0x7E,0x11,0x11,0x11,0x7E}},{'B',{0x7F,0x49,0x49,0x49,0x36}},{'C',{0x3E,0x41,0x41,0x41,0x22}},{'D',{0x7F,0x41,0x41,0x22,0x1C}},
 {'E',{0x7F,0x49,0x49,0x49,0x41}},{'F',{0x7F,9,9,9,1}},{'G',{0x3E,0x41,0x49,0x49,0x7A}},{'H',{0x7F,8,8,8,0x7F}},
 {'I',{0,0x41,0x7F,0x41,0}},{'J',{0x20,0x40,0x41,0x3F,1}},{'K',{0x7F,8,0x14,0x22,0x41}},{'L',{0x7F,0x40,0x40,0x40,0x40}},
 {'M',{0x7F,2,0x0C,2,0x7F}},{'N',{0x7F,4,8,0x10,0x7F}},{'O',{0x3E,0x41,0x41,0x41,0x3E}},{'P',{0x7F,9,9,9,6}},
 {'Q',{0x3E,0x41,0x51,0x21,0x5E}},{'R',{0x7F,9,0x19,0x29,0x46}},{'S',{0x46,0x49,0x49,0x49,0x31}},{'T',{1,1,0x7F,1,1}},
 {'U',{0x3F,0x40,0x40,0x40,0x3F}},{'V',{0x1F,0x20,0x40,0x20,0x1F}},{'W',{0x3F,0x40,0x38,0x40,0x3F}},{'X',{0x63,0x14,8,0x14,0x63}},
 {'Y',{7,8,0x70,8,7}},{'Z',{0x61,0x51,0x49,0x45,0x43}},
};
static const uint8_t *glyph(char c) {
    for (const Glyph &g : FONT) if (g.c == c) return g.col;
    return FONT[0].col;
}

static void send_cmds(const uint8_t *c, size_t n) {
    uint8_t buf[32]; buf[0] = 0x00; memcpy(buf + 1, c, n);
    i2c_master_write_to_device(I2C_NUM_0, ADDR, buf, n + 1, pdMS_TO_TICKS(100));
}

void oled_init() {
    i2c_config_t cfg = {};
    cfg.mode = I2C_MODE_MASTER;
    cfg.sda_io_num = (gpio_num_t)PIN_OLED_SDA;
    cfg.scl_io_num = (gpio_num_t)PIN_OLED_SCL;
    cfg.sda_pullup_en = GPIO_PULLUP_ENABLE; cfg.scl_pullup_en = GPIO_PULLUP_ENABLE;
    cfg.master.clk_speed = 400000;
    i2c_param_config(I2C_NUM_0, &cfg);
    i2c_driver_install(I2C_NUM_0, I2C_MODE_MASTER, 0, 0, 0);
    static const uint8_t init[] = {0xAE,0xD5,0x80,0xA8,0x3F,0xD3,0x00,0x40,0x8D,0x14,0x20,0x00,
                                   0xA1,0xC8,0xDA,0x12,0x81,0xCF,0xD9,0xF1,0xDB,0x40,0xA4,0xA6,0xAF};
    send_cmds(init, sizeof init);
    oled_clear(); oled_flush();
}

void oled_clear() { memset(fb, 0, sizeof fb); }

static void px(int x, int y) {
    if (x < 0 || x >= 128 || y < 0 || y >= 64) return;
    fb[x + (y / 8) * 128] |= (1 << (y % 8));
}

void oled_text(int x, int y, const char *s, int scale) {
    for (; *s; s++, x += 6 * scale) {
        const uint8_t *col = glyph((char)toupper((unsigned char)*s));
        for (int cx = 0; cx < 5; cx++)
            for (int cy = 0; cy < 7; cy++)
                if (col[cx] & (1 << cy))
                    for (int dx = 0; dx < scale; dx++)
                        for (int dy = 0; dy < scale; dy++)
                            px(x + cx * scale + dx, y + cy * scale + dy);
    }
}

void oled_flush() {
    const uint8_t win[] = {0x21, 0, 127, 0x22, 0, 7};
    send_cmds(win, sizeof win);
    uint8_t buf[129]; buf[0] = 0x40;
    for (int p = 0; p < 8; p++) {
        memcpy(buf + 1, fb + p * 128, 128);
        i2c_master_write_to_device(I2C_NUM_0, ADDR, buf, sizeof buf, pdMS_TO_TICKS(100));
    }
}

void oled_power(bool on) { uint8_t c = on ? 0xAF : 0xAE; send_cmds(&c, 1); }